## config/west.yml
```yaml
manifest:
  remotes:
    - name: zmkfirmware
      url-base: https://github.com/zmkfirmware
  projects:
    - name: zmk
      remote: zmkfirmware
      repo-path: zmk
      revision: main
      import: app/west.yml
  self:
    path: config
```
